## build/Kconfig/Kconfig.modules
```kconfig
menu "golioth-firmware-sdk (C:/Users/Brian/modules/lib/golioth-firmware-sdk)"
osource "C:/Users/Brian/modules/lib/golioth-firmware-sdk/port/zephyr/Kconfig"
config ZEPHYR_GOLIOTH_FIRMWARE_SDK_MODULE
	bool
	default y
endmenu
menu "pouch (C:/Users/Brian/pouch)"
osource "C:/Users/Brian/pouch/Kconfig"
config ZEPHYR_POUCH_MODULE
	bool
	default y
endmenu
menu "cmsis (C:/Users/Brian/modules/hal/cmsis)"
osource "$(ZEPHYR_CMSIS_KCONFIG)"
config ZEPHYR_CMSIS_MODULE
	bool
	default y
endmenu
menu "hal_nordic (C:/Users/Brian/modules/hal/nordic)"
osource "$(ZEPHYR_HAL_NORDIC_KCONFIG)"
config ZEPHYR_HAL_NORDIC_MODULE
	bool
	default y

config ZEPHYR_HAL_NORDIC_MODULE_BLOBS
	bool
endmenu
menu "hal_nxp (C:/Users/Brian/modules/hal/nxp)"
osource "$(ZEPHYR_HAL_NXP_KCONFIG)"
config ZEPHYR_HAL_NXP_MODULE
	bool
	default y
	select TAINT_BLOBS

config ZEPHYR_HAL_NXP_MODULE_BLOBS
	bool
	default y
endmenu
menu "littlefs (C:/Users/Brian/modules/fs/littlefs)"
osource "$(ZEPHYR_LITTLEFS_KCONFIG)"
config ZEPHYR_LITTLEFS_MODULE
	bool
	default y
endmenu
menu "mbedtls (C:/Users/Brian/modules/crypto/mbedtls)"
osource "$(ZEPHYR_MBEDTLS_KCONFIG)"
config ZEPHYR_MBEDTLS_MODULE
	bool
	default y
endmenu
config ZEPHYR_MCUBOOT_MODULE
	bool
	default y
menu "picolibc (C:/Users/Brian/modules/lib/picolibc)"
osource "C:/Users/Brian/modules/lib/picolibc/zephyr/Kconfig"
config ZEPHYR_PICOLIBC_MODULE
	bool
	default y
endmenu
menu "segger (C:/Users/Brian/modules/debug/segger)"
osource "$(ZEPHYR_SEGGER_KCONFIG)"
config ZEPHYR_SEGGER_MODULE
	bool
	default y
endmenu
menu "zcbor (C:/Users/Brian/modules/lib/zcbor)"
osource "$(ZEPHYR_ZCBOR_KCONFIG)"
config ZEPHYR_ZCBOR_MODULE
	bool
	default y
endmenu
config ZEPHYR_NRF_HW_MODELS_MODULE
	bool
	default y
```

## build/Kconfig/Kconfig.sysbuild.modules
```kconfig
config ZEPHYR_GOLIOTH_FIRMWARE_SDK_MODULE
   bool
   default y
config ZEPHYR_POUCH_MODULE
   bool
   default y
config ZEPHYR_CMSIS_MODULE
   bool
   default y
config ZEPHYR_HAL_NORDIC_MODULE
   bool
   default y
config ZEPHYR_HAL_NXP_MODULE
   bool
   default y
config ZEPHYR_LITTLEFS_MODULE
   bool
   default y
config ZEPHYR_MBEDTLS_MODULE
   bool
   default y
config ZEPHYR_MCUBOOT_MODULE
   bool
   default y
config ZEPHYR_PICOLIBC_MODULE
   bool
   default y
config ZEPHYR_SEGGER_MODULE
   bool
   default y
config ZEPHYR_ZCBOR_MODULE
   bool
   default y
config ZEPHYR_NRF_HW_MODELS_MODULE
   bool
   default y
```

## examples/ble_gatt/build/Kconfig/arch/Kconfig
```kconfig
# Load Zephyr Arch Kconfig descriptions.
osource "C:/Users/Brian/zephyr/arch/x86/Kconfig"
osource "C:/Users/Brian/zephyr/arch/xtensa/Kconfig"
osource "C:/Users/Brian/zephyr/arch/sparc/Kconfig"
osource "C:/Users/Brian/zephyr/arch/riscv/Kconfig"
osource "C:/Users/Brian/zephyr/arch/posix/Kconfig"
osource "C:/Users/Brian/zephyr/arch/nios2/Kconfig"
osource "C:/Users/Brian/zephyr/arch/mips/Kconfig"
osource "C:/Users/Brian/zephyr/arch/arm64/Kconfig"
osource "C:/Users/Brian/zephyr/arch/arm/Kconfig"
osource "C:/Users/Brian/zephyr/arch/arc/Kconfig"
```

## examples/ble_gatt/build/Kconfig/boards/Kconfig.defconfig
```kconfig
# Load Zephyr board defconfig descriptions.
osource "C:/Users/Brian/zephyr/boards/seeed/xiao_ble/Kconfig.defconfig"
```

## examples/ble_gatt/build/ble_gatt/Kconfig/Kconfig.shield
```kconfig
osource "C:/Users/Brian/modules/lib/golioth-firmware-sdk/zephyr/boards/shields/*/Kconfig.shield"
```

## examples/ble_gatt/build/ble_gatt/Kconfig/boards/Kconfig.xiao_ble
```kconfig
# Load board Kconfig descriptions.
osource "C:/Users/Brian/zephyr/boards/seeed/xiao_ble/Kconfig.xiao_ble"
```

## examples/ble_gatt/build/mcuboot/Kconfig/boards/Kconfig
```kconfig
# Load Zephyr board Kconfig descriptions.
osource "C:/Users/Brian/zephyr/boards/seeed/xiao_ble/Kconfig"
```

## examples/ble_gatt/build/mcuboot/Kconfig/boards/Kconfig.sysbuild
```kconfig
# Load Sysbuild board Kconfig descriptions.
osource "C:/Users/Brian/zephyr/boards/seeed/xiao_ble/Kconfig.sysbuild"
```

## examples/ble_gatt/build/mcuboot/Kconfig/soc/Kconfig.sysbuild
```kconfig
# Load Sysbuild SoC Kconfig descriptions.
osource "C:/Users/Brian/zephyr/soc/xlnx/zynqmp/Kconfig.sysbuild"
osource "C:/Users/Brian/zephyr/soc/xlnx/zynq7000/Kconfig.sysbuild"
osource "C:/Users/Brian/zephyr/soc/xen/Kconfig.sysbuild"
osource "C:/Users/Brian/zephyr/soc/wch/ch32v/Kconfig.sysbuild"
osource "C:/Users/Brian/zephyr/soc/ti/simplelink/Kconfig.sysbuild"
osource "C:/Users/Brian/zephyr/soc/ti/lm3s6965/Kconfig.sysbuild"
osource "C:/Users/Brian/zephyr/soc/ti/k3/Kconfig.sysbuild"
osource "C:/Users/Brian/zephyr/soc/telink/tlsr/Kconfig.sysbuild"
osource "C:/Users/Brian/zephyr/soc/starfive/jh71xx/Kconfig.sysbuild"
osource "C:/Users/Brian/zephyr/soc/st/stm32/Kconfig.sysbuild"
osource "C:/Users/Brian/zephyr/soc/snps/qemu_arc/Kconfig.sysbuild"
osource "C:/Users/Brian/zephyr/soc/snps/nsim/arc_v/Kconfig.sysbuild"
osource "C:/Users/Brian/zephyr/soc/snps/nsim/arc_classic/Kconfig.sysbuild"
osource "C:/Users/Brian/zephyr/soc/snps/hsdk4xd/Kconfig.sysbuild"
osource "C:/Users/Brian/zephyr/soc/snps/hsdk/Kconfig.sysbuild"
osource "C:/Users/Brian/zephyr/soc/snps/emsk/Kconfig.sysbuild"
osource "C:/Users/Brian/zephyr/soc/snps/emsdp/Kconfig.sysbuild"
osource "C:/Users/Brian/zephyr/soc/snps/arc_iot/Kconfig.sysbuild"
osource "C:/Users/Brian/zephyr/soc/silabs/Kconfig.sysbuild"
osource "C:/Users/Brian/zephyr/soc/sifive/sifive_freedom/Kconfig.sysbuild"
osource "C:/Users/Brian/zephyr/soc/sensry/Kconfig.sysbuild"
osource "C:/Users/Brian/zephyr/soc/rockchip/Kconfig.sysbuild"
osource "C:/Users/Brian/zephyr/soc/renode/riscv_virtual/Kconfig.sysbuild"
osource "C:/Users/Brian/zephyr/soc/renode/cortex_r8_virtual/Kconfig.sysbuild"
osource "C:/Users/Brian/zephyr/soc/renesas/smartbond/Kconfig.sysbuild"
osource "C:/Users/Brian/zephyr/soc/renesas/rzt2m/Kconfig.sysbuild"
osource "C:/Users/Brian/zephyr/soc/renesas/rz/Kconfig.sysbuild"
osource "C:/Users/Brian/zephyr/soc/renesas/rcar/Kconfig.sysbuild"
osource "C:/Users/Brian/zephyr/soc/renesas/ra/Kconfig.sysbuild"
osource "C:/Users/Brian/zephyr/soc/realtek/ec/Kconfig.sysbuild"
osource "C:/Users/Brian/zephyr/soc/raspberrypi/rpi_pico/Kconfig.sysbuild"
osource "C:/Users/Brian/zephyr/soc/quicklogic/eos_s3/Kconfig.sysbuild"
osource "C:/Users/Brian/zephyr/soc/qemu/virt_riscv/Kconfig.sysbuild"
osource "C:/Users/Brian/zephyr/soc/qemu/malta/Kconfig.sysbuild"
osource "C:/Users/Brian/zephyr/soc/openisa/rv32m1/Kconfig.sysbuild"
osource "C:/Users/Brian/zephyr/soc/nxp/s32/Kconfig.sysbuild"
osource "C:/Users/Brian/zephyr/soc/nxp/rw/Kconfig.sysbuild"
osource "C:/Users/Brian/zephyr/soc/nxp/mcx/Kconfig.sysbuild"
osource "C:/Users/Brian/zephyr/soc/nxp/lpc/Kconfig.sysbuild"
osource "C:/Users/Brian/zephyr/soc/nxp/layerscape/Kconfig.sysbuild"
osource "C:/Users/Brian/zephyr/soc/nxp/kinetis/Kconfig.sysbuild"
osource "C:/Users/Brian/zephyr/soc/nxp/imxrt/Kconfig.sysbuild"
osource "C:/Users/Brian/zephyr/soc/nxp/imx/Kconfig.sysbuild"
osource "C:/Users/Brian/zephyr/soc/nuvoton/numicro/Kconfig.sysbuild"
osource "C:/Users/Brian/zephyr/soc/nuvoton/numaker/Kconfig.sysbuild"
osource "C:/Users/Brian/zephyr/soc/nuvoton/npcx/Kconfig.sysbuild"
osource "C:/Users/Brian/zephyr/soc/nuvoton/npcm/Kconfig.sysbuild"
osource "C:/Users/Brian/zephyr/soc/nordic/Kconfig.sysbuild"
osource "C:/Users/Brian/zephyr/soc/neorv32/Kconfig.sysbuild"
osource "C:/Users/Brian/zephyr/soc/native/inf_clock/Kconfig.sysbuild"
osource "C:/Users/Brian/zephyr/soc/microchip/miv/Kconfig.sysbuild"
osource "C:/Users/Brian/zephyr/soc/microchip/mec/Kconfig.sysbuild"
osource "C:/Users/Brian/zephyr/soc/mediatek/mt8xxx/Kconfig.sysbuild"
osource "C:/Users/Brian/zephyr/soc/lowrisc/opentitan/Kconfig.sysbuild"
osource "C:/Users/Brian/zephyr/soc/litex/litex_vexriscv/Kconfig.sysbuild"
osource "C:/Users/Brian/zephyr/soc/ite/ec/Kconfig.sysbuild"
osource "C:/Users/Brian/zephyr/soc/intel/raptor_lake/Kconfig.sysbuild"
osource "C:/Users/Brian/zephyr/soc/intel/lakemont/Kconfig.sysbuild"
osource "C:/Users/Brian/zephyr/soc/intel/intel_socfpga_std/Kconfig.sysbuild"
osource "C:/Users/Brian/zephyr/soc/intel/intel_socfpga/Kconfig.sysbuild"
osource "C:/Users/Brian/zephyr/soc/intel/intel_niosv/Kconfig.sysbuild"
osource "C:/Users/Brian/zephyr/soc/intel/intel_ish/Kconfig.sysbuild"
osource "C:/Users/Brian/zephyr/soc/intel/intel_adsp/Kconfig.sysbuild"
osource "C:/Users/Brian/zephyr/soc/intel/elkhart_lake/Kconfig.sysbuild"
osource "C:/Users/Brian/zephyr/soc/intel/atom/Kconfig.sysbuild"
osource "C:/Users/Brian/zephyr/soc/intel/apollo_lake/Kconfig.sysbuild"
osource "C:/Users/Brian/zephyr/soc/intel/alder_lake/Kconfig.sysbuild"
osource "C:/Users/Brian/zephyr/soc/infineon/cat3/Kconfig.sysbuild"
osource "C:/Users/Brian/zephyr/soc/infineon/cat1b/Kconfig.sysbuild"
osource "C:/Users/Brian/zephyr/soc/infineon/cat1a/Kconfig.sysbuild"
osource "C:/Users/Brian/zephyr/soc/gd/gd32/Kconfig.sysbuild"
osource "C:/Users/Brian/zephyr/soc/gaisler/leon3/Kconfig.sysbuild"
osource "C:/Users/Brian/zephyr/soc/gaisler/gr716a/Kconfig.sysbuild"
osource "C:/Users/Brian/zephyr/soc/espressif/Kconfig.sysbuild"
osource "C:/Users/Brian/zephyr/soc/ene/kb1200/Kconfig.sysbuild"
osource "C:/Users/Brian/zephyr/soc/efinix/sapphire/Kconfig.sysbuild"
osource "C:/Users/Brian/zephyr/soc/cdns/xtensa_sample_controller/Kconfig.sysbuild"
osource "C:/Users/Brian/zephyr/soc/cdns/sample_controller32/Kconfig.sysbuild"
osource "C:/Users/Brian/zephyr/soc/cdns/dc233c/Kconfig.sysbuild"
osource "C:/Users/Brian/zephyr/soc/brcm/bcmvk/Kconfig.sysbuild"
osource "C:/Users/Brian/zephyr/soc/brcm/bcm2712/Kconfig.sysbuild"
osource "C:/Users/Brian/zephyr/soc/brcm/bcm2711/Kconfig.sysbuild"
osource "C:/Users/Brian/zephyr/soc/atmel/sam0/Kconfig.sysbuild"
osource "C:/Users/Brian/zephyr/soc/atmel/sam/Kconfig.sysbuild"
osource "C:/Users/Brian/zephyr/soc/aspeed/Kconfig.sysbuild"
osource "C:/Users/Brian/zephyr/soc/arm/Kconfig.sysbuild"
osource "C:/Users/Brian/zephyr/soc/arm/beetle/Kconfig.sysbuild"
osource "C:/Users/Brian/zephyr/soc/antmicro/myra/Kconfig.sysbuild"
osource "C:/Users/Brian/zephyr/soc/andestech/Kconfig.sysbuild"
osource "C:/Users/Brian/zephyr/soc/amd/acp_6_0/Kconfig.sysbuild"
osource "C:/Users/Brian/zephyr/soc/ambiq/Kconfig.sysbuild"
osource "C:/Users/Brian/zephyr/soc/altr/zephyr_nios2f/Kconfig.sysbuild"
osource "C:/Users/Brian/zephyr/soc/altr/qemu_nios2/Kconfig.sysbuild"
osource "C:/Users/Brian/zephyr/soc/adi/max32/Kconfig.sysbuild"
```
